<?php
###########################################################################################
# File   : welcome_text.inc(3)
# ~~~~~~~~~~~~~~~~~~~~~~~~~~~~~~~
# Function:
# ---------
# Gestion de la base de données
# -----------------------------------------------------------------------------------------
#
echo "
<div style='position:absolute;top:5%;left:50%;width:900px;margin-left:-450px;height:410px;border:0px solid red;
  opacity: 0.70;_filter: alpha(opacity=70);'>
  <div style='position:absolute;top:4px;left:16px;right:16px;bottom:4px;
    font-family:arial,Helvetica;font-size:12px;color:#606060;margin:0px;
    box-shadow:0px 0px 10px yellow;background-color:ivory;border-radius:16px;-moz-border-radius:16px;'>

    <div class=dBlueArial12B style='position:absolute;top:56px;left:74px;right:12px;margin:0px;border:0px;padding:0px;
      font-size:14px;font-weight:normal;color:black;cursor:default;'>
    <p>Trouver imm&eacute;diatement les r&eacute;ponses les plus pertinentes &agrave; son besoin, tout le monde en a r&ecirc;v&eacute;.
    Pourquoi pas ici ?<br>Quand il n'y a pas ce que vous cherchez,
    <SPAN style='font-weight:normal;font-style:italic;'>ajoutez-le</SPAN>. C'est tr&egrave;s simple :</p>

    <p>Lancer la <SPAN style='font-weight:bold;'>&laquo; m&ecirc;me recherche &raquo;</SPAN> dans un nouvel onglet
    avec l'un des 4 moteurs en bas de page.</p>

    <p>Ensuite, cliquez sur le bouton <SPAN style='font-weight:bold;'>&laquo; sugg&eacute;rer
    <SPAN style='font-weight:bold;'>un nouvel index &raquo;</SPAN><SPAN style='font-weight:normal;'>.<br>
    <SPAN style='font-weight:normal;font-style:italic;'>(il faut au moins 2 mots dans le champ recherche pour
    le voir appara&icirc;tre)</SPAN></p>
    
    <p>Vous n'aurez que 3 champs &agrave; remplir :
    <ol><li>Un texte explicatif du contenu de la page cible,</li>
    <li>Un suite de mots-cl&eacute;s pertinents s&eacute;par&eacute;s par des virgules
    <SPAN style='font-weight:normal;font-style:italic;'>(aucun espace et aucun accent)</SPAN>,</li>
    <li>Coller <SPAN style='font-weight:normal;font-style:italic;'>(avec Control+V)</SPAN> l'URL de la page cible.</li></ol>
    
    Apr&egrave;s validation par l'un des administrateurs, tout le monde pourra profiter de l'index que vous aurez soumis.
    
    </div>

    <div class=dBlueArial12B style='position:absolute;top:100%;left:12px;right:12px;height:52px;margin:0px;border:0px;cursor:default;
	margin-top:-80px;padding:10px 0px 0px 12px;background-color:$color7;border-radius:14px;-moz-border-radius:14px;'>
	Si vous n'&ecirc;tes pas satisfait par ce r&eacute;sultat, vous pouvez:

	<div class=whiteArial12B
	  style='position:absolute;top:5px;left:357px;margin:0px;padding:2px 10px 2px 12px;background-color:$color5;
	  border:2px solid $color14;color:$color14;border-radius:10px;-moz-border-radius:10px;white-space:nowrap;cursor:default;'>
	  sugg&eacute;rer un nouvel index</div>

	<div class=whiteArial12B
	  style='position:absolute;top:5px;left:561px;margin:0px;padding:2px 10px 2px 12px;background-color:$color5;
	  border:2px solid $color14;color:$color14;border-radius:10px;-moz-border-radius:10px;white-space:nowrap;cursor:default;'>
	  lancer cette recherche sur Qwant</div>

	<div class=whiteArial12B
	  style='position:absolute;top:35px;left:20px;margin:0px;padding:2px 10px 2px 12px;background-color:$color5;
	  border:2px solid $color14;color:$color14;border-radius:10px;-moz-border-radius:10px;white-space:nowrap;cursor:default;'>
	  lancer cette recherche sur DuckDuckGo</div>

	<div class=whiteArial12B
	  style='position:absolute;top:35px;left:307px;margin:0px;padding:2px 10px 2px 12px;background-color:$color5;
	  border:2px solid $color14;color:$color14;border-radius:10px;-moz-border-radius:10px;white-space:nowrap;cursor:default;'>
	  lancer cette recherche sur Google</div>

	<div class=whiteArial12B
	  style='position:absolute;top:35px;left:560px;margin:0px;padding:2px 10px 2px 12px;background-color:$color5;
	  border:2px solid $color14;color:$color14;border-radius:10px;-moz-border-radius:10px;white-space:nowrap;cursor:default;'>
	  lancer cette recherche sur Ecosia</div>
    </div>
  </div>

  <div class=rbanner_left style='border-color:transparent $color17 transparent transparent;'></div>
  <div class=rbanner_right style='border-color:transparent transparent transparent $color17;'></div>
  <div class=rbanner_text style='background-color:$color14;color:white;cursor:default;'>
  Le moteur de recherche collaboratif qui veut vous faire gagner du temps</div>
</div>";
#
#~~~~~~~~~~~~~~~
# End of script
#~~~~~~~~~~~~~~~~
?>